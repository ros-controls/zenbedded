## CMakeLists.txt
```
cmake_minimum_required(VERSION 3.20.0)

if(NOT DEFINED ENV{ZENBEDDED_MODULE_ROOT})
  message(FATAL_ERROR "Set ZENBEDDED_MODULE_ROOT to the Zenbedded repository root")
endif()
list(APPEND ZEPHYR_EXTRA_MODULES $ENV{ZENBEDDED_MODULE_ROOT})
find_package(Zephyr REQUIRED HINTS $ENV{ZEPHYR_BASE})
project(zenbedded_external_consumer)

target_sources(app PRIVATE src/main.c)

if(CONFIG_ZENBEDDED_RCL)
  target_sources(app PRIVATE src/client_smoke.cpp)
endif()
```

## sample.yaml
```
sample:
  name: Zenbedded external consumer
common:
  build_only: true
  tags: zenbedded module
tests:
  sample.zenbedded.consumer.disabled:
    platform_allow:
      - native_sim/native/64
      - esp32s3_devkitc/esp32s3/procpu
  sample.zenbedded.consumer.c_transport:
    platform_allow:
      - native_sim/native/64
      - esp32s3_devkitc/esp32s3/procpu
    extra_configs:
      - CONFIG_ZENBEDDED=y
      - CONFIG_ZENBEDDED_TIER_1=y
      - CONFIG_ZENBEDDED_RCL=n
  sample.zenbedded.consumer.cpp_client:
    platform_allow:
      - native_sim/native/64
      - esp32s3_devkitc/esp32s3/procpu
    extra_configs:
      - CONFIG_ZENBEDDED=y
      - CONFIG_ZENBEDDED_TIER_2=y
      - CONFIG_ZENBEDDED_TIER2_SCHEMA_PATH="interface_schema.yaml"
      - CONFIG_CPP=y
      - CONFIG_STD_CPP17=y
      - CONFIG_ZENBEDDED_RCL=y
```

## prj.conf
```kconfig
CONFIG_ZENBEDDED=n
```

## src/main.c
```c
#include <zephyr/kernel.h>

#ifdef CONFIG_ZENBEDDED_RCL
int zenbedded_client_link_smoke(void);
#endif

int main(void)
{
#ifdef CONFIG_ZENBEDDED_RCL
  return zenbedded_client_link_smoke();
#else
  return 0;
#endif
}
```

## src/client_smoke.cpp
```c
#include <zenbedded/rcl/zenbedded_client.hpp>

#include <zenbedded_transport/generated/interface_data.h>

using Client = ZenbeddedClient<RawCodec<zenbedded_state_t>, RawCodec<zenbedded_command_t>>;

static Client client;

extern "C" int zenbedded_client_link_smoke()
{
  zenbedded_state_t state{};
  zenbedded_command_t command{};

  int result = client.init(1);
  client.write_state(state);
  client.read_command(command);
  client.destroy();
  return result;
}
```
