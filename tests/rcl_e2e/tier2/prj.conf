## CMakeLists.txt
```
cmake_minimum_required(VERSION 3.20.0)

list(APPEND ZEPHYR_EXTRA_MODULES
        "${CMAKE_CURRENT_LIST_DIR}/../../../zenbedded_transport"
        "${CMAKE_CURRENT_LIST_DIR}/../../../zenbedded_rcl"
)

find_package(Zephyr REQUIRED HINTS $ENV{ZEPHYR_BASE})

project(rcl_e2e_tier2)
target_sources(app PRIVATE src/main.cpp)
```

## sample.yaml
```
sample:
  name: Zenbedded RCL e2e tier2 test
common:
  tags: zenoh
tests:
  sample.zenbedded.rcl_e2e_tier2:
    harness: pytest
    platform_allow:
      - native_sim/native/64
    extra_configs:
      - CONFIG_ZENBEDDED_TRANSPORT_DYNAMIC_PORT_OVERRIDE=y
    harness_config:
      pytest_dut_scope: function
      pytest_args: ["-o", "env=PYTEST_DISABLE_PLUGIN_AUTOLOAD=1"]
```

## prj.conf
```kconfig
CONFIG_CPP=y
CONFIG_STD_CPP17=y
CONFIG_REQUIRES_FULL_LIBC=y

CONFIG_ZENBEDDED_TIER_2=y

CONFIG_ZENBEDDED_RCL=y
CONFIG_ZENBEDDED_RCL_PUB_TOPIC="/test_motor/state"
CONFIG_ZENBEDDED_RCL_SUB_TOPIC="/test_motor/cmd"

CONFIG_ZENBEDDED_ZENOH_LOCATOR="127.0.0.1:7447"
CONFIG_ZENBEDDED_QOS_RELIABLE=y

CONFIG_SYS_CLOCK_TICKS_PER_SEC=1000
CONFIG_CBPRINTF_FP_SUPPORT=y
```

## boards/esp32s3_devkitc_esp32s3_procpu.conf
```kconfig
CONFIG_POSIX_API=y
CONFIG_NEWLIB_LIBC=y
CONFIG_NEWLIB_LIBC_NANO=n
CONFIG_GLIBCXX_LIBCPP=y
```

## src/main.cpp
```c
// Copyright 2026 Open Source Robotics Foundation, Inc.
// Licensed under the Apache License, Version 2.0

#include <stdint.h>
#include <stdio.h>
#include <zephyr/kernel.h>
#include <zephyr/sys/printk.h>

#include "zenbedded_rcl/codecs.hpp"
#include "zenbedded_rcl/zenbedded_client.hpp"
#include "zenbedded_transport/generated/interface_data.h"

int main()
{
  printk("--- Zenbedded RCL Tier 2 Single-Threaded Node ---\n");

  // Instantiate the client using RawCodec for Tier 2 POD passthrough
  ZenbeddedClient<RawCodec<zenbedded_state_t>, RawCodec<zenbedded_command_t>> client;

  // Initialize client at 100Hz (spawns the background publish thread natively handled by the client
  // base)
  if (client.init(100) != 0)
  {
    printk("Failed to initialize ZenbeddedClient\n");
    return -1;
  }

  zenbedded_state_t current_state = {0.0, 0.0};
  zenbedded_command_t latest_cmd = {0.0};

  uint32_t loop_counter = 0;
  printk("[SYS] Entering Main Event Loop\n");

  while (1)
  {
    // Poll incoming commands non-blockingly from the client buffer
    zenbedded_command_t cmd;
    if (client.read_command(cmd))
    {
      latest_cmd = cmd;
    }

    // Perform state updates sequentially in the main thread
    current_state.test_motor_position += 0.01;
    current_state.test_motor_velocity = latest_cmd.test_motor_effort * 0.5;

    // Commit state write to the client double-buffer for transmission
    client.write_state(current_state);

    loop_counter++;
    if (loop_counter % 1000 == 0)
    {
      printk(
        "Processed 1000 Loops | Pos: %.2f | Last Eff: %.2f\n", current_state.test_motor_position,
        latest_cmd.test_motor_effort);
    }

    // Rate-limit main loop execution to 100Hz (10ms)
    k_sleep(K_MSEC(10));
  }

  return 0;
}
```
