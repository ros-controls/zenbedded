## Kconfig
```
mainmenu "Zenoh E2E Test"

source "Kconfig.zephyr"

menu "Zenoh E2E Test Configuration"

config ZENOH_E2E_INGRESS
    bool "Enable host-to-firmware test traffic"
    default n
    depends on ZENOH_PICO
    select ZENOH_PICO_SUBSCRIPTION

config ZENOH_E2E_EGRESS
    bool "Enable firmware-to-host test traffic"
    default n
    depends on ZENOH_PICO
    select ZENOH_PICO_PUBLICATION

config ZENOH_E2E_PERIOD_MS
    int "Firmware egress publication period in milliseconds"
    default 1000
    range 1 60000

config ZENOH_E2E_DYNAMIC_PORT_OVERRIDE
    bool "Enable runtime dynamic Zenoh port override from environment"
    default n
    depends on ARCH_POSIX
    help
      When enabled, reads ZENBEDDED_ZENOH_PORT at runtime via getenv() to override the
      target endpoint.
      When disabled (default), the static ENDPOINT is used.

endmenu
```

## sample.yaml
```
sample:
  description: Configurable Zenoh E2E string-message test
  name: zenoh e2e
common:
  harness: pytest
  extra_configs:
    - CONFIG_ZENOH_E2E_DYNAMIC_PORT_OVERRIDE=y
  harness_config:
    pytest_dut_scope: function
    pytest_args:
      - '-p'
      - 'no:launch_testing'
      - '-p'
      - 'no:launch_ros'
tests:
  sample.zenbedded.zenoh_e2e.ingress_frequent:
    platform_allow:
      - native_sim/native/64
    extra_configs:
      - CONFIG_ZENOH_E2E_INGRESS=y
      - CONFIG_ZENOH_E2E_EGRESS=n
    harness_config:
      pytest_dut_scope: function
      pytest_args:
        - '-p'
        - 'no:launch_testing'
        - '-p'
        - 'no:launch_ros'
        - '-k'
        - 'test_ingress_frequent'

  sample.zenbedded.zenoh_e2e.ingress_infrequent:
    platform_allow:
      - native_sim/native/64
    timeout: 75
    extra_configs:
      - CONFIG_ZENOH_E2E_INGRESS=y
      - CONFIG_ZENOH_E2E_EGRESS=n
      - CONFIG_ZENOH_E2E_PERIOD_MS=15000
    harness_config:
      pytest_dut_scope: function
      pytest_args:
        - '-p'
        - 'no:launch_testing'
        - '-p'
        - 'no:launch_ros'
        - '-k'
        - 'test_ingress_infrequent'

  sample.zenbedded.zenoh_e2e.ingress_after_lease_idle:
    platform_allow:
      - native_sim/native/64
    timeout: 35
    extra_configs:
      - CONFIG_ZENOH_E2E_INGRESS=y
      - CONFIG_ZENOH_E2E_EGRESS=n
      - CONFIG_ZENOH_E2E_PERIOD_MS=1000
    harness_config:
      pytest_dut_scope: function
      pytest_args:
        - '-p'
        - 'no:launch_testing'
        - '-p'
        - 'no:launch_ros'
        - '-k'
        - 'test_ingress_after_lease_idle'

  sample.zenbedded.zenoh_e2e.egress_frequent:
    platform_allow:
      - native_sim/native/64
    extra_configs:
      - CONFIG_ZENOH_E2E_INGRESS=n
      - CONFIG_ZENOH_E2E_EGRESS=y
    harness_config:
      pytest_dut_scope: function
      pytest_args:
        - '-p'
        - 'no:launch_testing'
        - '-p'
        - 'no:launch_ros'
        - '-k'
        - 'test_egress_frequent'

  sample.zenbedded.zenoh_e2e.egress_infrequent:
    platform_allow:
      - native_sim/native/64
    timeout: 75
    extra_configs:
      - CONFIG_ZENOH_E2E_INGRESS=n
      - CONFIG_ZENOH_E2E_EGRESS=y
      - CONFIG_ZENOH_E2E_PERIOD_MS=15000
    harness_config:
      pytest_dut_scope: function
      pytest_args:
        - '-p'
        - 'no:launch_testing'
        - '-p'
        - 'no:launch_ros'
        - '-k'
        - 'test_egress_infrequent'

  sample.zenbedded.zenoh_e2e.issue_65_outbound_only_reconnect:
    platform_allow:
      - native_sim/native/64
    timeout: 125
    extra_configs:
      - CONFIG_ZENOH_E2E_INGRESS=y
      - CONFIG_ZENOH_E2E_EGRESS=y
      - CONFIG_ZENOH_E2E_PERIOD_MS=100
    harness_config:
      pytest_dut_scope: function
      pytest_args:
        - '-p'
        - 'no:launch_testing'
        - '-p'
        - 'no:launch_ros'
        - '-k'
        - 'test_issue_65_outbound_only_reconnect'

  sample.zenbedded.zenoh_e2e.bidirectional_frequent:
    platform_allow:
      - native_sim/native/64
    extra_configs:
      - CONFIG_ZENOH_E2E_INGRESS=y
      - CONFIG_ZENOH_E2E_EGRESS=y
    harness_config:
      pytest_dut_scope: function
      pytest_args:
        - '-p'
        - 'no:launch_testing'
        - '-p'
        - 'no:launch_ros'
        - '-k'
        - 'test_bidirectional_frequent'

  sample.zenbedded.zenoh_e2e.bidirectional_infrequent:
    platform_allow:
      - native_sim/native/64
    timeout: 75
    extra_configs:
      - CONFIG_ZENOH_E2E_INGRESS=y
      - CONFIG_ZENOH_E2E_EGRESS=y
      - CONFIG_ZENOH_E2E_PERIOD_MS=15000
    harness_config:
      pytest_dut_scope: function
      pytest_args:
        - '-p'
        - 'no:launch_testing'
        - '-p'
        - 'no:launch_ros'
        - '-k'
        - 'test_bidirectional_infrequent'
```

## prj.conf
```kconfig
CONFIG_POSIX_API=y
CONFIG_POSIX_THREADS=y
CONFIG_POSIX_TIMERS=y

CONFIG_NETWORKING=y
CONFIG_NET_SOCKETS=y

CONFIG_ZENOH_PICO=y
CONFIG_ZENOH_PICO_LINK_TCP=y
CONFIG_ZENOH_PICO_MULTI_THREAD=y
CONFIG_ZENOH_PICO_SUBSCRIPTION=y

CONFIG_HEAP_MEM_POOL_SIZE=32768
CONFIG_MAIN_STACK_SIZE=4096
```

## src/main.c
```c
// Copyright 2026 Open Source Robotics Foundation, Inc.
//
// Licensed under the Apache License, Version 2.0 (the "License");
// you may not use this file except in compliance with the License.
// You may obtain a copy of the License at
//
//     http://www.apache.org/licenses/LICENSE-2.0
//
// Unless required by applicable law or agreed to in writing, software
// distributed under the License is distributed on an "AS IS" BASIS,
// WITHOUT WARRANTIES OR CONDITIONS OF ANY KIND, either express or implied.
// See the License for the specific language governing permissions and
// limitations under the License.

#include <stdbool.h>
#include <stdint.h>
#include <stdio.h>

#if defined(CONFIG_ZENOH_E2E_DYNAMIC_PORT_OVERRIDE)
#if defined(CONFIG_ARCH_POSIX)
#include <nsi_host_trampolines.h>
#define GET_ENV_VAR(name) nsi_host_getenv(name)
#else
#include <stdlib.h>
#define GET_ENV_VAR(name) getenv(name)
#endif
#endif

#include <zenoh-pico.h>
#include <zephyr/kernel.h>

#define ENDPOINT "tcp/127.0.0.1:7447"
#define INGRESS_TOPIC "zenbedded/e2e/ingress"
#define EGRESS_TOPIC "zenbedded/e2e/egress"
#define EGRESS_MESSAGE_PREFIX "hello from the firmware: "

#if defined(CONFIG_ZENOH_E2E_INGRESS)
#define INGRESS_STATE "on"
#else
#define INGRESS_STATE "off"
#endif

#if defined(CONFIG_ZENOH_E2E_EGRESS)
#define EGRESS_STATE "on"
#else
#define EGRESS_STATE "off"
#endif

#if defined(CONFIG_ZENOH_E2E_INGRESS)
static void on_test_message(z_loaned_sample_t * sample, void * arg)
{
  ARG_UNUSED(arg);

  z_owned_string_t payload;
  if (z_bytes_to_string(z_sample_payload(sample), &payload) < 0)
  {
    printf("Received test message: <invalid payload>\n");
    return;
  }

  printf(
    "Received test message: %.*s\n", (int)z_string_len(z_loan(payload)),
    z_string_data(z_loan(payload)));
  z_drop(z_move(payload));
}
#endif

int main(void)
{
  z_owned_config_t config;
  z_owned_session_t session;

  z_config_default(&config);

  const char * endpoint = ENDPOINT;
#if defined(CONFIG_ZENOH_E2E_DYNAMIC_PORT_OVERRIDE)
  const char * env_endpoint = GET_ENV_VAR("ZENBEDDED_ZENOH_ENDPOINT");
  const char * env_port = GET_ENV_VAR("ZENBEDDED_ZENOH_PORT");
  static char dynamic_endpoint[64];
  if (env_endpoint != NULL && env_endpoint[0] != '\0')
  {
    endpoint = env_endpoint;
  }
  else if (env_port != NULL && env_port[0] != '\0')
  {
    snprintf(dynamic_endpoint, sizeof(dynamic_endpoint), "tcp/127.0.0.1:%s", env_port);
    endpoint = dynamic_endpoint;
  }
#endif

  zp_config_insert(z_loan_mut(config), Z_CONFIG_MODE_KEY, "client");
  zp_config_insert(z_loan_mut(config), Z_CONFIG_CONNECT_KEY, endpoint);

  printf("Connecting client to %s\n", endpoint);

  if (z_open(&session, z_move(config), NULL) < 0)
  {
    printf("Zenoh connection failed\n");
    return 1;
  }

  if (zp_start_read_task(z_loan_mut(session), NULL) < 0)
  {
    printf("Zenoh read task failed to start\n");
    z_close(z_loan_mut(session), NULL);
    return 1;
  }

  if (zp_start_lease_task(z_loan_mut(session), NULL) < 0)
  {
    printf("Zenoh lease task failed to start\n");
    zp_stop_read_task(z_loan_mut(session));
    z_close(z_loan_mut(session), NULL);
    return 1;
  }

#if defined(CONFIG_ZENOH_E2E_INGRESS)
  z_view_keyexpr_t ingress_keyexpr;
  z_view_keyexpr_from_str_unchecked(&ingress_keyexpr, INGRESS_TOPIC);

  z_owned_closure_sample_t ingress_callback;
  z_closure(&ingress_callback, on_test_message, NULL, NULL);

  z_owned_subscriber_t ingress_subscriber;
  if (
    z_declare_subscriber(
      z_loan(session), &ingress_subscriber, z_loan(ingress_keyexpr), z_move(ingress_callback),
      NULL) < 0)
  {
    printf("Zenoh subscriber declaration failed\n");
    zp_stop_lease_task(z_loan_mut(session));
    zp_stop_read_task(z_loan_mut(session));
    z_close(z_loan_mut(session), NULL);
    return 1;
  }
#endif

#if defined(CONFIG_ZENOH_E2E_EGRESS)
  z_view_keyexpr_t egress_keyexpr;
  z_view_keyexpr_from_str_unchecked(&egress_keyexpr, EGRESS_TOPIC);

  z_owned_publisher_t egress_publisher;
  if (z_declare_publisher(z_loan(session), &egress_publisher, z_loan(egress_keyexpr), NULL) < 0)
  {
    printf("Zenoh publisher declaration failed\n");
    zp_stop_lease_task(z_loan_mut(session));
    zp_stop_read_task(z_loan_mut(session));
    z_close(z_loan_mut(session), NULL);
    return 1;
  }
#endif

  printf(
    "Zenoh client connected (ingress=%s, egress=%s, period_ms=%d)\n", INGRESS_STATE, EGRESS_STATE,
    CONFIG_ZENOH_E2E_PERIOD_MS);

#if defined(CONFIG_ZENOH_E2E_EGRESS)
  uint32_t message_sequence = 1;
  bool egress_started = false;
#endif
  for (;;)
  {
#if defined(CONFIG_ZENOH_E2E_EGRESS)
    if (!egress_started)
    {
      z_matching_status_t matching_status;
      if (z_publisher_get_matching_status(z_loan(egress_publisher), &matching_status) < 0)
      {
        printf("Zenoh publisher matching status failed\n");
        return 1;
      }

      if (!matching_status.matching)
      {
        k_sleep(K_MSEC(50));
        continue;
      }

      egress_started = true;
    }

    char message[64];
    int message_length = snprintf(
      message, sizeof(message), "%s%u", EGRESS_MESSAGE_PREFIX, (unsigned int)message_sequence++);
    if (message_length > 0 && (size_t)message_length < sizeof(message))
    {
      z_owned_bytes_t payload;
      z_bytes_from_static_buf(&payload, (const uint8_t *)message, (size_t)message_length);

      if (z_publisher_put(z_loan(egress_publisher), z_move(payload), NULL) < 0)
      {
        printf("Zenoh test message publish failed\n");
      }
    }

    k_sleep(K_MSEC(CONFIG_ZENOH_E2E_PERIOD_MS));
#else
    k_sleep(K_FOREVER);
#endif
  }

  return 0;
}
```
