## CMakeLists.txt
```
cmake_minimum_required(VERSION 3.20.0)

set(ZENBEDDED_SCHEMA_FILE ${CMAKE_CURRENT_SOURCE_DIR}/interface_schema.yaml)

include(${CMAKE_CURRENT_LIST_DIR}/../common/common.cmake)

find_package(Zephyr REQUIRED HINTS $ENV{ZEPHYR_BASE})

project(rcl_cpp_test)
target_sources(app PRIVATE src/main.cpp)
```

## prj.conf
```kconfig
CONFIG_CPP=y
CONFIG_STD_CPP17=y
CONFIG_GLIBCXX_LIBCPP=y
CONFIG_REQUIRES_FULL_LIBC=y
CONFIG_POSIX_API=y

CONFIG_ZENBEDDED_TIER_2=y
CONFIG_ZENBEDDED_TIER2_SCHEMA_PATH="interface_schema.yaml"

CONFIG_ZENBEDDED_RCL=y
CONFIG_ZENBEDDED_QOS_RELIABLE=y
CONFIG_ZENBEDDED_RCL_PUB_TOPIC="zenbedded/test/state"
CONFIG_ZENBEDDED_RCL_SUB_TOPIC="zenbedded/test/cmd"

CONFIG_SHELL=y
CONFIG_LOG=y

CONFIG_TEST_RANDOM_GENERATOR=y
CONFIG_ENTROPY_GENERATOR=y

CONFIG_SAMPLE_USBD_PRODUCT="Zenbedded Test Node"
```

## boards/esp32s3_devkitc_esp32s3_procpu.overlay
```dts
#include <cdc_ecm_overlay.dtsi>

&wifi {
	status = "okay";
};
```

## src/main.cpp
```c
// Copyright 2026 Open Source Robotics Foundation, Inc.
//
// Licensed under the Apache License, Version 2.0 (the "License");
// you may not use this file except in compliance with the License.
// You may obtain a copy of the License at
//
//     http://www.apache.org/licenses/LICENSE-2.0
//
// Unless required by applicable law or agreed to in writing, software
// distributed under the License is distributed on an "AS IS" BASIS,
// WITHOUT WARRANTIES OR CONDITIONS OF ANY KIND, either express or implied.
// See the License for the specific language governing permissions and
// limitations under the License.

#include <zenbedded_transport/generated/interface_data.h>
#include <zephyr/kernel.h>
#include <zephyr/logging/log.h>
#include <zephyr/net/net_if.h>
#include <cmath>
#include <zenbedded_demo_net.hpp>
#include <zenbedded_rcl/zenbedded_client.hpp>

LOG_MODULE_REGISTER(zenbedded_test_node, LOG_LEVEL_INF);

using TestClient = ZenbeddedClient<RawCodec<zenbedded_state_t>, RawCodec<zenbedded_command_t>>;

constexpr uint32_t kControlFreqHz = 50;
constexpr int kIterations = 200;  // ~4s at 50Hz

static void report(bool pass, const char * msg)
{
  if (pass)
  {
    LOG_INF("PASS: %s", msg);
  }
  else
  {
    LOG_ERR("FAIL: %s", msg);
  }
}

int main(void)
{
  LOG_INF("starting test node");

  net_if * iface = net_if_get_default();
  if (int net_err = zenbedded::demo::init_network(iface); net_err != 0)
  {
    LOG_ERR("Failed to initialize network interface: %d", net_err);
    return net_err;
  }

  static TestClient client;

  int ret = client.init(kControlFreqHz);
  report(ret == 0, "client.init() returned 0");
  if (ret != 0)
  {
    LOG_ERR("init failed with %d, aborting", ret);
    return ret;
  }
  report(client.is_initialized(), "client.is_initialized() is true after init()");

  bool cmd_val_changed = false;
  int write_calls = 0;

  zenbedded_state_t s{};
  zenbedded_command_t cmd{};

  for (int i = 0; i < kIterations; i++)
  {
    double di = static_cast<double>(i);
    s.motor_arm_position = sin(di * 0.1) * 90.0;
    s.pendulum_axis_position = di * 0.01;

    client.write_state(s);
    write_calls++;

    client.read_command(cmd);

    if (i % 20 == 0)
    {
      LOG_INF(
        "iter=%d state.motor_arm=%.2f "
        "state.pendulum=%.2f cmd.motor_arm=%.2f",
        i, s.motor_arm_position, s.pendulum_axis_position, cmd.motor_arm_position);
    }

    // check if the value changes
    if (fabs(cmd.motor_arm_position) >= 1e-9)
    {
      cmd_val_changed = true;
    }

    k_sleep(K_MSEC(1000 / kControlFreqHz));
  }

  report(write_calls == kIterations, "write_state() called for every iteration without crashing");

  report(
    cmd_val_changed,
    "received at least one non-zero command "
    "(requires tools/zenoh_echo_node.py running)");

  LOG_INF("is_control_thread_running=%d", client.is_control_thread_running());

  // --- destroy() ---
  client.destroy();
  report(!client.is_initialized(), "client.destroy() left client uninitialized");

  LOG_INF("done");
  return 0;
}
```
