## CMakeLists.txt
```
cmake_minimum_required(VERSION 3.20.0)

set(ZENBEDDED_SCHEMA_FILE ${CMAKE_CURRENT_SOURCE_DIR}/interface_schema.yaml)

include(${CMAKE_CURRENT_LIST_DIR}/../../common/common.cmake)

find_package(Zephyr REQUIRED HINTS $ENV{ZEPHYR_BASE})

project(sine_wave)
target_sources(app PRIVATE src/main.cpp)
target_compile_definitions(app PRIVATE _GNU_SOURCE _USE_MATH_DEFINES)
```

## Kconfig
```
menu "Sine Wave Zephyr Demo"

config ZENBEDDED_ZENOH_IP_PORT
    default "192.0.2.1:7447" if ZENBEDDED_DEMO_COMM_USB_CDC
    default "10.75.105.128:7447" if ZENBEDDED_DEMO_COMM_WIFI

endmenu

source "Kconfig.zephyr"
```

## sample.yaml
```
sample:
  name: Sine Wave Zephyr demo
common:
  build_only: true
  tags: zenbedded
tests:
  sample.zenbedded.sine_wave.wifi:
    platform_allow:
      - esp32s3_devkitc/esp32s3/procpu
    extra_args:
      - -DSNIPPET=wifi
  sample.zenbedded.sine_wave.usb_cdc:
    platform_allow:
      - esp32s3_devkitc/esp32s3/procpu
    extra_args:
      - -DSNIPPET=cdc-ecm
```

## prj.conf
```kconfig
CONFIG_CPP=y
CONFIG_STD_CPP17=y
CONFIG_GLIBCXX_LIBCPP=y
CONFIG_REQUIRES_FULL_LIBC=y
CONFIG_POSIX_API=y

CONFIG_ZENBEDDED_TIER_2=y
CONFIG_ZENBEDDED_TIER2_SCHEMA_PATH="interface_schema.yaml"

CONFIG_ZENBEDDED_RCL=y
CONFIG_ZENBEDDED_QOS_RELIABLE=y
CONFIG_ZENBEDDED_RCL_PUB_TOPIC="zenbedded/sine_wave/state"
CONFIG_ZENBEDDED_RCL_SUB_TOPIC="zenbedded/sine_wave/cmd"

CONFIG_SHELL=y
CONFIG_LOG=y

CONFIG_TEST_RANDOM_GENERATOR=y
CONFIG_ENTROPY_GENERATOR=y

CONFIG_ZENBEDDED_DEMO_USBD_PRODUCT="Sine Wave Zephyr"
```

## boards/esp32s3_devkitc_esp32s3_procpu.conf
```kconfig
# boards/esp32s3_devkitc_esp32s3_procpu.conf
# Extra Kconfig applied only when building for ESP32-S3

CONFIG_SETTINGS=y
CONFIG_NVS=y
CONFIG_FLASH=y
CONFIG_FLASH_MAP=y
CONFIG_HEAP_MEM_POOL_SIZE=65536
CONFIG_NET_BUF_RX_COUNT=32
CONFIG_NET_BUF_TX_COUNT=32
CONFIG_NET_BUF_DATA_SIZE=512
CONFIG_NET_PKT_RX_COUNT=64
CONFIG_NET_PKT_TX_COUNT=64
CONFIG_NET_RX_STACK_SIZE=4096
CONFIG_NET_TX_STACK_SIZE=4096
```

## boards/esp32s3_devkitc_esp32s3_procpu.overlay
```dts
/ {
	cdc_ecm_eth0: cdc_ecm_eth0 {
		compatible = "zephyr,cdc-ecm-ethernet";
		remote-mac-address = "00005E005301";
	};
};

&wifi {
	status = "okay";
};
```

## src/main.cpp
```c
// Copyright 2026 Open Source Robotics Foundation, Inc.
//
// Licensed under the Apache License, Version 2.0 (the "License");
// you may not use this file except in compliance with the License.
// You may obtain a copy of the License at
//
//     http://www.apache.org/licenses/LICENSE-2.0
//
// Unless required by applicable law or agreed to in writing, software
// distributed under the License is distributed on an "AS IS" BASIS,
// WITHOUT WARRANTIES OR CONDITIONS OF ANY KIND, either express or implied.
// See the License for the specific language governing permissions and
// limitations under the License.

#include <errno.h>
#include <zenbedded_transport/generated/interface_data.h>
#include <zephyr/kernel.h>
#include <zephyr/logging/log.h>
#include <zephyr/net/net_if.h>
#include <cmath>
#include <zenbedded_demo_net.hpp>
#include <zenbedded_rcl/zenbedded_client.hpp>

LOG_MODULE_REGISTER(sine_wave_zephyr, LOG_LEVEL_INF);

using SineWaveClient = ZenbeddedClient<RawCodec<zenbedded_state_t>, RawCodec<zenbedded_command_t>>;

double wave_amp = 5;
double wave_frequency = 1.4;  // hz
uint32_t loop_freq = 100;     // hz

int main()
{
  LOG_INF("starting Sine Wave Zephyr App");
  net_if * iface = net_if_get_default();
  if (int net_err = zenbedded::demo::init_network(iface); net_err != 0)
  {
    LOG_ERR("Failed to initialize network interface: %d", net_err);
    return net_err;
  }

  static SineWaveClient client;

  int ret = client.init(loop_freq);
  if (ret != 0)
  {
    LOG_ERR("ZenbeddedClient.init failed with %d, aborting", ret);
    return ret;
  }

  int64_t start_time = k_uptime_get();  // Get kernel boot time in ms
  int32_t cnt = 0;
  bool cmd_recv = false;
  zenbedded_state_t state{};
  zenbedded_command_t cmd{};

  while (true)
  {
    client.read_command(cmd);

    if (fabs(cmd.sine_wave_amplitude) >= 1e-6)
    {
      cmd_recv = true;
    }
    if (cmd_recv)
    {
      wave_amp = fabs(cmd.sine_wave_amplitude);
    }

    auto current_time_ms = static_cast<double>(k_uptime_get() - start_time);
    double x = 2.0 * M_PI * current_time_ms * wave_frequency / 1000.0;
    state.sine_wave_position = wave_amp * sin(x);

    if (++cnt == 500)
    {
      LOG_INF("Running...");
      cnt = 0;
    }

    client.write_state(state);

    k_sleep(K_MSEC(20));
  }

  client.destroy();
  return 0;
}
```
