## demos/common/Kconfig
```kconfig
# Copyright 2026 Open Source Robotics Foundation, Inc.
#
# Licensed under the Apache License, Version 2.0 (the "License");
# you may not use this file except in compliance with the License.
# You may obtain a copy of the License at
#
#     http://www.apache.org/licenses/LICENSE-2.0
#
# Unless required by applicable law or agreed to in writing, software
# distributed under the License is distributed on an "AS IS" BASIS,
# WITHOUT WARRANTIES OR CONDITIONS OF ANY KIND, either express or implied.
# See the License for the specific language governing permissions and
# limitations under the License.

menuconfig ZENBEDDED_DEMO_COMMON
    bool "Zenbedded Demo Common Infrastructure"
    default y
    help
      Shared infrastructure for Zenbedded demo applications (USB CDC Ethernet,
      Wi-Fi station bringup, logging stack hardening, and DHCPv4 server).

if ZENBEDDED_DEMO_COMMON

choice ZENBEDDED_DEMO_COMM_INTERFACE
    prompt "Demo Communication Transport Interface"
    default ZENBEDDED_DEMO_COMM_USB_CDC
    help
      Select the physical transport used to connect the MCU to the Zenoh network / Host PC.

    config ZENBEDDED_DEMO_COMM_USB_CDC
        bool "USB CDC (Ethernet) Interface"
        select USB_DEVICE_STACK_NEXT
        select NET_L2_ETHERNET
        select USBD_CDC_ECM_CLASS
        help
          Connect over USB CDC ECM (Ethernet emulation) for low-latency wired communication.

    config ZENBEDDED_DEMO_COMM_WIFI
        bool "Wi-Fi Interface"
        select WIFI
        select WIFI_NM
        select WIFI_CREDENTIALS
        select WIFI_CREDENTIALS_CONNECT_STORED
        select NET_L2_WIFI_SHELL
        select WIFI_CREDENTIALS_SHELL
        select NET_DHCPV4
        help
          Connect over 802.11 Wi-Fi station mode using stored credentials.

endchoice

# Backward-compatibility aliases for existing code checking legacy symbols
config INVERTED_PENDULUM_COMM_USB_CDC
    bool
    default y if ZENBEDDED_DEMO_COMM_USB_CDC

config INVERTED_PENDULUM_COMM_WIFI
    bool
    default y if ZENBEDDED_DEMO_COMM_WIFI

config SINE_WAVE_COMM_USB_CDC
    bool
    default y if ZENBEDDED_DEMO_COMM_USB_CDC

config SINE_WAVE_COMM_WIFI
    bool
    default y if ZENBEDDED_DEMO_COMM_WIFI

# Conditional Wi-Fi enablement on ESP32
config WIFI_ESP32
    default y if ZENBEDDED_DEMO_COMM_WIFI && SOC_FAMILY_ESPRESSIF_ESP32

config ESP32_WIFI_STA_AUTO_DHCPV4
    default y if ZENBEDDED_DEMO_COMM_WIFI && SOC_FAMILY_ESPRESSIF_ESP32

config ESP32_WIFI_STA_RECONNECT
    default y if ZENBEDDED_DEMO_COMM_WIFI && SOC_FAMILY_ESPRESSIF_ESP32

if ZENBEDDED_DEMO_COMM_USB_CDC

    config ZENBEDDED_DEMO_USB_CDC_STATIC_IP
        bool "Configure static IPv4 address on USB CDC interface"
        default y
        select NET_CONFIG_SETTINGS
        help
          Configure deterministic static IPv4 address for the USB CDC interface.

    config ZENBEDDED_DEMO_USB_CDC_MY_IPV4_ADDR
        string "Device USB CDC IPv4 address"
        depends on ZENBEDDED_DEMO_USB_CDC_STATIC_IP
        default "192.0.2.2"

    config ZENBEDDED_DEMO_USB_CDC_PEER_IPV4_ADDR
        string "Host PC USB CDC IPv4 address"
        depends on ZENBEDDED_DEMO_USB_CDC_STATIC_IP
        default "192.0.2.1"

    config ZENBEDDED_DEMO_USB_CDC_NETMASK
        string "Device USB CDC IPv4 Netmask"
        depends on ZENBEDDED_DEMO_USB_CDC_STATIC_IP
        default "255.255.255.0"

    config NET_CONFIG_MY_IPV4_ADDR
        default ZENBEDDED_DEMO_USB_CDC_MY_IPV4_ADDR if ZENBEDDED_DEMO_USB_CDC_STATIC_IP

    config NET_CONFIG_PEER_IPV4_ADDR
        default ZENBEDDED_DEMO_USB_CDC_PEER_IPV4_ADDR if ZENBEDDED_DEMO_USB_CDC_STATIC_IP

    config NET_CONFIG_MY_IPV4_NETMASK
        default ZENBEDDED_DEMO_USB_CDC_NETMASK if ZENBEDDED_DEMO_USB_CDC_STATIC_IP

    config ZENBEDDED_DEMO_USBD_VID
        hex "USB device Vendor ID"
        default 0x303a if SOC_FAMILY_ESPRESSIF_ESP32
        default 0x2fe3
        help
          USB device Vendor ID (VID). Default is Espressif (0x303a) or Zephyr (0x2fe3).

    config ZENBEDDED_DEMO_USBD_PID
        hex "USB device Product ID"
        default 0x0001
        help
          USB device Product ID (PID).

    config ZENBEDDED_DEMO_USBD_MANUFACTURER
        string "USB device manufacturer string"
        default SAMPLE_USBD_MANUFACTURER if SAMPLE_USBD_MANUFACTURER != ""
        default "Open Source Robotics Foundation"

    config ZENBEDDED_DEMO_USBD_PRODUCT
        string "USB device product string"
        default SAMPLE_USBD_PRODUCT if SAMPLE_USBD_PRODUCT != ""
        default "Zenbedded Demo"

    config ZENBEDDED_DEMO_USBD_MAX_POWER
        int "USB device max power consumption (2mA units)"
        default 125
        help
          Maximum power in 2mA units (125 = 250mA).

    # Backward compatibility aliases
    config SAMPLE_USBD_PRODUCT
        string "USB product string (legacy alias)"
        default ""

    config SAMPLE_USBD_MANUFACTURER
        string "USB manufacturer string (legacy alias)"
        default ""

    config ZENBEDDED_DEMO_USB_CDC_DHCPV4_SERVER
        bool "Run DHCPv4 server on USB CDC interface"
        default y
        depends on ZENBEDDED_DEMO_USB_CDC_STATIC_IP
        select NET_DHCPV4_SERVER
        select NET_UDP
        help
          Leases peer IPv4 address to host PC for zero-config plug-and-play.

    config NET_DHCPV4_SERVER_ADDR_COUNT
        default 1 if ZENBEDDED_DEMO_USB_CDC_DHCPV4_SERVER

    config NET_DHCPV4_SERVER_ICMP_PROBE_TIMEOUT
        default 0 if ZENBEDDED_DEMO_USB_CDC_DHCPV4_SERVER

    config NET_DHCPV4_SERVER_OPTION_ROUTER
        default n if ZENBEDDED_DEMO_USB_CDC_DHCPV4_SERVER

endif # ZENBEDDED_DEMO_COMM_USB_CDC

# Logging stack hardening defaults
config LOG_PROCESS_THREAD_STACK_SIZE
    default 4096 if LOG

config LOG_BUFFER_SIZE
    default 4096 if LOG

config SHELL_BACKEND_SERIAL_LOG_MESSAGE_QUEUE_SIZE
    default 2048 if SHELL_BACKEND_SERIAL

config SHELL_STACK_SIZE
    default 3072 if SHELL

endif # ZENBEDDED_DEMO_COMMON
```

## zenbedded_common/Kconfig
```kconfig
# Copyright 2026 Open Source Robotics Foundation, Inc.
#
# Licensed under the Apache License, Version 2.0 (the "License");
# you may not use this file except in compliance with the License.
# You may obtain a copy of the License at
#
#     http://www.apache.org/licenses/LICENSE-2.0
#
# Unless required by applicable law or agreed to in writing, software
# distributed under the License is distributed on an "AS IS" BASIS,
# WITHOUT WARRANTIES OR CONDITIONS OF ANY KIND, either express or implied.
# See the License for the specific language governing permissions and
# limitations under the License.

menuconfig ZENBEDDED_COMMON
    bool "Zenbedded Common Library"
    default y
    help
      Common network bringup and USB utilities for Zenbedded applications.

if ZENBEDDED_COMMON

config ZENBEDDED_COMMON_USB_CDC
    bool "USB CDC (Ethernet) Interface"
    default n
    select USB_DEVICE_STACK_NEXT
    select NET_L2_ETHERNET
    select USBD_CDC_ECM_CLASS
    help
      Connect over USB CDC ECM (Ethernet emulation) for wired communication.

config ZENBEDDED_COMM_USB_CDC
    bool
    default y if ZENBEDDED_COMMON_USB_CDC

config ZENBEDDED_COMMON_WIFI
    bool "Wi-Fi Interface"
    default n
    select WIFI
    select WIFI_NM
    select WIFI_CREDENTIALS
    select WIFI_CREDENTIALS_CONNECT_STORED
    select NET_L2_WIFI_SHELL
    select WIFI_CREDENTIALS_SHELL
    select NET_DHCPV4
    help
      Connect over 802.11 Wi-Fi station mode using stored credentials.

config ZENBEDDED_COMM_WIFI
    bool
    default y if ZENBEDDED_COMMON_WIFI

config NET_MAX_CONTEXTS
    default 10 if (ZENBEDDED_COMMON_USB_CDC || ZENBEDDED_COMM_USB_CDC) && (ZENBEDDED_COMMON_WIFI || ZENBEDDED_COMM_WIFI)

config NET_IF_MAX_IPV4_COUNT
    default 2 if (ZENBEDDED_COMMON_USB_CDC || ZENBEDDED_COMM_USB_CDC) && (ZENBEDDED_COMMON_WIFI || ZENBEDDED_COMM_WIFI)

if ZENBEDDED_COMMON_USB_CDC || ZENBEDDED_COMM_USB_CDC

    config ZENBEDDED_USB_CDC_STATIC_IP
        bool "Configure static IPv4 address on USB CDC interface"
        default y
        select NET_CONFIG_SETTINGS
        help
          Configure deterministic static IPv4 address for the USB CDC interface.

    config ZENBEDDED_USB_CDC_MY_IPV4_ADDR
        string "Device USB CDC IPv4 address"
        depends on ZENBEDDED_USB_CDC_STATIC_IP
        default "192.0.2.2"

    config ZENBEDDED_USB_CDC_PEER_IPV4_ADDR
        string "Host PC USB CDC IPv4 address"
        depends on ZENBEDDED_USB_CDC_STATIC_IP
        default "192.0.2.1"

    config ZENBEDDED_USB_CDC_NETMASK
        string "Device USB CDC IPv4 Netmask"
        depends on ZENBEDDED_USB_CDC_STATIC_IP
        default "255.255.255.0"

    config NET_CONFIG_MY_IPV4_ADDR
        default ZENBEDDED_USB_CDC_MY_IPV4_ADDR if ZENBEDDED_USB_CDC_STATIC_IP

    config NET_CONFIG_PEER_IPV4_ADDR
        default ZENBEDDED_USB_CDC_PEER_IPV4_ADDR if ZENBEDDED_USB_CDC_STATIC_IP

    config NET_CONFIG_MY_IPV4_NETMASK
        default ZENBEDDED_USB_CDC_NETMASK if ZENBEDDED_USB_CDC_STATIC_IP

    config ZENBEDDED_USBD_VID
        hex "USB device Vendor ID"
        default 0x303a if SOC_FAMILY_ESPRESSIF_ESP32
        default 0x2fe3
        help
          USB device Vendor ID (VID). Default is Espressif (0x303a) or Zephyr (0x2fe3).

    config ZENBEDDED_USBD_PID
        hex "USB device Product ID"
        default 0x0001
        help
          USB device Product ID (PID).

    config ZENBEDDED_USBD_MANUFACTURER
        string "USB device manufacturer string"
        default "Open Source Robotics Foundation"

    config ZENBEDDED_USBD_PRODUCT
        string "USB device product string"
        default "Zenbedded Demo"

    config ZENBEDDED_USBD_MAX_POWER
        int "USB device max power consumption (2mA units)"
        default 125
        help
          Maximum power in 2mA units (125 = 250mA).

    config ZENBEDDED_USB_CDC_DHCPV4_SERVER
        bool "Run DHCPv4 server on USB CDC interface"
        default y
        depends on ZENBEDDED_USB_CDC_STATIC_IP
        select NET_DHCPV4_SERVER
        select NET_UDP
        help
          Leases peer IPv4 address to host PC for zero-config plug-and-play.

    config NET_DHCPV4_SERVER_ADDR_COUNT
        default 1 if ZENBEDDED_USB_CDC_DHCPV4_SERVER

    config NET_DHCPV4_SERVER_ICMP_PROBE_TIMEOUT
        default 0 if ZENBEDDED_USB_CDC_DHCPV4_SERVER

    config NET_DHCPV4_SERVER_OPTION_ROUTER
        default n if ZENBEDDED_USB_CDC_DHCPV4_SERVER

endif # ZENBEDDED_COMMON_USB_CDC

endif # ZENBEDDED_COMMON
```

## zenbedded_rcl/Kconfig
```kconfig
menu "Zenbedded RCL Configuration"

if ZENBEDDED

    config ZENBEDDED_RCL
        bool "Enable Zenbedded RCL"
        default n
        depends on CPP && STD_CPP_VERSION >= 201703
        help
          This option enables the Zenbedded Ros Client Library (RCL).

    config ZENBEDDED_RCL_THREAD_PRIORITY
        int "Zenbedded thread priority"
        default 1
        depends on ZENBEDDED_RCL
        help
            Zephyr thread priority for the zenbedded thread.
            Lower number = higher priority.

    config ZENBEDDED_RCL_THREAD_STACK_SIZE
        int "zenbedded thread stack size (bytes)"
        default 4096
        range 1024 16384
        depends on ZENBEDDED_RCL
        help
            Stack size for the zenbedded thread.

    config ZENBEDDED_MAX_STATE_BUFFER_SIZE
        int "Maximum size of state message (for static allocation)"
        default 256
        range 32 2048
        depends on ZENBEDDED_RCL
        help
            Sizes both state double-buffer slots and a temporary of the same
            size that zenoh_publish_state() places on the control thread's
            stack, so raising this eats into ZENBEDDED_RCL_THREAD_STACK_SIZE.

    config ZENBEDDED_MAX_CMD_BUFFER_SIZE
        int "Maximum size of cmd message (for static allocation)"
        default 256
        range 32 2048
        depends on ZENBEDDED_RCL
        help
            Sizes both command double-buffer slots and a temporary of the same
            size that read_command() places on the calling thread's stack.

    config ZENBEDDED_RCL_PUB_TOPIC
        string "Name of the topic for publishing"
        default "zenbedded/state"
        depends on ZENBEDDED_RCL

    config ZENBEDDED_RCL_SUB_TOPIC
        string "name of the topic for subscribing"
        default "zenbedded/cmd"
        depends on ZENBEDDED_RCL

    if ZENBEDDED_RCL && ZENBEDDED_TIER_1
        choice ZENBEDDED_RCL_STATE_MSG_TYPE
            prompt "State (published) message type for tier 1"
            default ZENBEDDED_RCL_STATE_MSG_JOINT_STATE
            help
              ROS 2 message type serialized onto ZENBEDDED_RCL_PUB_TOPIC.

            config ZENBEDDED_RCL_STATE_MSG_JOINT_STATE
                bool "sensor_msgs/msg/JointState"

            # Imu, Float64MultiArray and Twist are disabled until each has a
            # codec in codecs.hpp and an entry in RIHS_LEDGER. Without both, the
            # keyexpr ends in UNKNOWN_HASH and no rmw_zenoh peer ever matches.
            #
            # config ZENBEDDED_RCL_STATE_MSG_IMU
            #     bool "sensor_msgs/msg/Imu"
            #
            # config ZENBEDDED_RCL_STATE_MSG_FLOAT64_MULTI_ARRAY
            #     bool "std_msgs/msg/Float64MultiArray"
            #
            # config ZENBEDDED_RCL_STATE_MSG_TWIST
            #     bool "geometry_msgs/msg/Twist"
        endchoice

        # Hidden string config for State message
        config ZENBEDDED_RCL_STATE_MSG_TYPE_STRING
            string
            default "sensor_msgs::msg::dds_::JointState_" if ZENBEDDED_RCL_STATE_MSG_JOINT_STATE

        choice ZENBEDDED_RCL_CMD_MSG_TYPE
            prompt "Command (subscribed) message type"
            default ZENBEDDED_RCL_CMD_MSG_JOINT_COMMAND
            help
              ROS 2 message type deserialized from ZENBEDDED_RCL_SUB_TOPIC.

            config ZENBEDDED_RCL_CMD_MSG_JOINT_COMMAND
                bool "control_msgs/msg/JointCommand"

            # Disabled for the same reason as the state types above.
            #
            # config ZENBEDDED_RCL_CMD_MSG_FLOAT64_MULTI_ARRAY
            #     bool "std_msgs/msg/Float64MultiArray"
            #
            # config ZENBEDDED_RCL_CMD_MSG_TWIST
            #     bool "geometry_msgs/msg/Twist"
        endchoice

        # Hidden string config for Command message
        config ZENBEDDED_RCL_CMD_MSG_TYPE_STRING
            string
            default "control_msgs::msg::dds_::JointCommand_" if ZENBEDDED_RCL_CMD_MSG_JOINT_COMMAND

    endif # ZENBEDDED_TIER_1

endif # ZENBEDDED

endmenu
```
